## main/Kconfig.projbuild
```kconfig
menu "Elering Smart Relay"

    config WIFI_SSID
        string "WiFi SSID"
        default "myssid"
        help
            Name of the WiFi network to connect to.

    config WIFI_PASSWORD
        string "WiFi Password"
        default "mypassword"
        help
            Password for the WiFi network.

    config RELAY_GPIO
        int "Relay GPIO pin number"
        default 22
        help
            GPIO pin connected to the relay IN pin (default: GPIO10 on ESP32-C3).

    config RELAY_ACTIVE_LOW
        bool "Relay activates on LOW (most relay modules)"
        default y
        help
            Enable if your relay module activates when GPIO is LOW.
            Disable if relay activates on HIGH.

    config HOURS_WINDOW
        int "Hours window to consider"
        default 12
        range 2 24
        help
            Number of upcoming hours to analyse for cheap/expensive selection.

    config CHEAP_HOURS
        int "Number of cheap hours to activate relay"
        default 6
        range 1 23
        help
            How many of the cheapest hours in the window the relay should be ON.

    config LCD_ST7789
        bool "Use ST7789 display driver (some CYD variants)"
        default n
        help
            Enable for CYD boards with an ST7789 display instead of the default ILI9341.
            Symptoms of wrong driver: blank/white screen or washed-out colours.

endmenu
```

## sdkconfig.defaults
```kconfig
CONFIG_MBEDTLS_CERTIFICATE_BUNDLE=y
CONFIG_MBEDTLS_CERTIFICATE_BUNDLE_DEFAULT_FULL=y
CONFIG_ESP_MAIN_TASK_STACK_SIZE=8192
CONFIG_PARTITION_TABLE_CUSTOM=y
CONFIG_PARTITION_TABLE_CUSTOM_FILENAME="partitions.csv"
CONFIG_ESPTOOLPY_FLASHSIZE_4MB=y
CONFIG_IDF_TARGET="esp32"
CONFIG_RELAY_GPIO=22
CONFIG_WIFI_SSID="EleringTest"
CONFIG_WIFI_PASSWORD="testpass1234"
CONFIG_HTTPD_MAX_REQ_HDR_LEN=1024
```
